## conf/layer.conf
```bitbake
# We have a conf and classes directory, add to BBPATH
BBPATH .= ":${LAYERDIR}"

# We have recipes-* directories, add to BBFILES
BBFILES += "${LAYERDIR}/recipes-*/*/*.bb \
            ${LAYERDIR}/recipes-*/*/*.bbappend"

BBFILE_COLLECTIONS += "myd-j1028x"
BBFILE_PATTERN_myd-j1028x = "^${LAYERDIR}/"
BBFILE_PRIORITY_myd-j1028x = "6"

LAYERDEPENDS_myd-j1028x = "core"
LAYERSERIES_COMPAT_myd-j1028x = "mickledore"

PREFERRED_RPROVIDER_linux-firmware-nxp9098-common = "firmware-nxp-wifi"
PREFERRED_RPROVIDER_linux-firmware-nxp8997-common = "firmware-nxp-wifi"
```

## conf/machine/ls1028amyd.conf
```bitbake
MACHINEOVERRIDES =. "fsl-lsch3:ls1028a:"

require conf/machine/include/qoriq-arm64.inc
require conf/machine/include/arm/arch-arm64.inc

MACHINE_FEATURES += "optee"
#MACHINE_FEATURES:remove = "optee"

KERNEL_CLASSES  = " kernel-fitimage "
KERNEL_IMAGETYPES = "fitImage"

UBOOT_DTB_LOADADDRESS = "0x90000000"
UBOOT_ENTRYPOINT = "0x80080000"

UBOOT_CONFIG ??= "tfa-secure-boot tfa"
UBOOT_CONFIG[tfa-secure-boot] = "ls1028amyd_tfa_SECURE_BOOT_defconfig"
UBOOT_CONFIG[tfa] = "ls1028amyd_tfa_defconfig"

KERNEL_DEVICETREE ?= "freescale/fsl-ls1028a-myd.dtb freescale/fsl-ls1028a-qds.dtb"
KERNEL_DEVICETREE:append:use-nxp-bsp = "\
    freescale/fsl-ls1028a-myd-dpdk.dtb \
"
KERNEL_DEFCONFIG ?= "defconfig"

SERIAL_CONSOLES ?= "115200;ttyS0 115200;ttyS1 115200;ttyAMA0"
SERIAL_CONSOLES_CHECK ?= "${SERIAL_CONSOLES}"


#RCWSD ?= "R_SQPP_0x85bb/rcw_1500_gpu600"
#RCWXSPI ?= "R_SQPP_0x85bb/rcw_1500_gpu600"
#RCWEMMC ?= "R_SQPP_0x85bb/rcw_1500_gpu600"
RCWSD ?= "R_SQPH_0x85be/rcw_myd_sata"
RCWXSPI ?= "R_SQPH_0x85be/rcw_myd_sata"
RCWEMMC ?= "R_SQPH_0x85be/rcw_myd_sata"

EXTRA_IMAGEDEPENDS += "rcw qoriq-atf dp-firmware-cadence"
USE_VT = "0"
```

## conf/machine/ls1028amyddistro.conf
```bitbake
MACHINE="ls1028amyd"
require conf/machine/ls1028amyd.conf

require conf/machine/include/ubuntubasics.inc

DISTRO_FEATURES:remove = "security"
```
